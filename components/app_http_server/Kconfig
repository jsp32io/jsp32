## components/app_http_server/Kconfig
```kconfig
menu "Application HTTP server"

    config APP_HTTP_SERVER_PORT
        int "HTTP server port"
        default 80
        range 1 65535

    config APP_HTTP_SERVER_MAX_HANDLERS
        int "Maximum URI handlers"
        default 48
        range 12 64

    config APP_HTTP_SERVER_MAX_OPEN_SOCKETS
        int "Maximum open sockets"
        default 7
        range 4 16

    config APP_HTTP_SERVER_TASK_STACK_SIZE
        int "HTTP server task stack size"
        default 8192
        range 4096 32768

endmenu
```

## components/app_registers/Kconfig
```kconfig
menu "Application registers"

    config APP_REGISTERS_X_COUNT
        int "X input bit count"
        default 256
        range 1 65535

    config APP_REGISTERS_Y_COUNT
        int "Y output bit count"
        default 256
        range 1 65535

    config APP_REGISTERS_M_COUNT
        int "M internal bit count"
        default 1024
        range 1 65535

    config APP_REGISTERS_D_COUNT
        int "D data word count"
        default 2048
        range 1 65535

    config APP_REGISTERS_MAX_TRANSACTION
        int "Maximum registers per atomic transaction"
        default 256
        range 1 4096

    config APP_REGISTERS_MAX_SUBSCRIBERS
        int "Maximum native change subscribers"
        default 8
        range 1 64

endmenu
```

## components/fs_http/Kconfig
```kconfig
menu "Filesystem HTTP API"

    config FS_HTTP_ENABLED
        bool "Enable the filesystem HTTP API"
        default y

    config FS_HTTP_MAX_FILE_SIZE
        int "Maximum uploaded file size"
        depends on FS_HTTP_ENABLED
        default 524288
        range 1024 4194304

    config FS_HTTP_MAX_CONCURRENT_REQUESTS
        int "Maximum concurrent file transfers"
        depends on FS_HTTP_ENABLED
        default 2
        range 1 4

    config FS_HTTP_TASK_STACK_SIZE
        int "File transfer worker stack size"
        depends on FS_HTTP_ENABLED
        default 6144
        range 4096 16384

    config FS_HTTP_TASK_PRIORITY
        int "File transfer worker priority"
        depends on FS_HTTP_ENABLED
        default 4
        range 1 24

    config FS_HTTP_PROTECT_MAIN_JS
        bool "Prevent deletion of /main.js"
        depends on FS_HTTP_ENABLED
        default y

endmenu
```

## components/js_adc/Kconfig
```kconfig
menu "JavaScript ADC"
    config JS_ADC_ENABLED
        bool "Enable the JavaScript ADC1 oneshot API"
        depends on IDF_TARGET_ESP32S3
        default y
endmenu
```

## components/js_gpio/Kconfig
```kconfig
menu "JavaScript GPIO"

    config JS_GPIO_ENABLED
        bool "Enable the JavaScript GPIO API"
        default y

    config JS_GPIO_MAX_WATCHERS
        int "Maximum JavaScript GPIO watchers"
        depends on JS_GPIO_ENABLED
        default 32
        range 1 256

endmenu
```

## components/js_http/Kconfig
```kconfig
menu "JavaScript HTTP API"

    config JS_HTTP_MAX_SSE_CLIENTS
        int "Maximum console SSE clients"
        default 2
        range 1 8
        help
            The effective limit always leaves at least one HTTP socket free.

    config JS_HTTP_SSE_TASK_STACK_SIZE
        int "Console SSE task stack size"
        default 6144
        range 4096 16384

    config JS_HTTP_SSE_TASK_PRIORITY
        int "Console SSE task priority"
        default 4
        range 1 24

    config JS_HTTP_SSE_HEARTBEAT_MS
        int "Console SSE heartbeat interval (ms)"
        default 15000
        range 1000 60000

    config JS_HTTP_EVAL_ENABLED
        bool "Enable the JavaScript eval HTTP API"
        default y

    config JS_HTTP_MAX_PENDING_EVALS
        int "Maximum concurrent eval requests"
        depends on JS_HTTP_EVAL_ENABLED
        default 2
        range 1 4

    config JS_HTTP_EVAL_MAX_BODY_SIZE
        int "Maximum eval request body size"
        depends on JS_HTTP_EVAL_ENABLED
        default 12288
        range 1024 65536

    config JS_HTTP_EVAL_MAX_SOURCE_SIZE
        int "Maximum JavaScript source size"
        depends on JS_HTTP_EVAL_ENABLED
        default 8192
        range 256 32768

    config JS_HTTP_EVAL_MAX_RESULT_SIZE
        int "Maximum serialized eval result size"
        depends on JS_HTTP_EVAL_ENABLED
        default 16384
        range 1024 65536

    config JS_HTTP_EVAL_DEFAULT_TIMEOUT_MS
        int "Default eval timeout (ms)"
        depends on JS_HTTP_EVAL_ENABLED
        default 5000
        range 100 30000

    config JS_HTTP_EVAL_MAX_TIMEOUT_MS
        int "Maximum eval timeout (ms)"
        depends on JS_HTTP_EVAL_ENABLED
        default 30000
        range 1000 120000

    config JS_HTTP_EVAL_TASK_STACK_SIZE
        int "Eval HTTP worker task stack size"
        depends on JS_HTTP_EVAL_ENABLED
        default 6144
        range 4096 16384

    config JS_HTTP_EVAL_TASK_PRIORITY
        int "Eval HTTP worker task priority"
        depends on JS_HTTP_EVAL_ENABLED
        default 4
        range 1 24

endmenu
```

## components/js_i2c/Kconfig
```kconfig
menu "JavaScript I2C"

    config JS_I2C_ENABLED
        bool "Enable the JavaScript I2C API"
        default y

    config JS_I2C_MAX_DEVICES_PER_BUS
        int "Maximum devices per I2C bus"
        depends on JS_I2C_ENABLED
        default 16
        range 1 64

    config JS_I2C_MAX_PENDING
        int "Maximum pending operations per I2C bus"
        depends on JS_I2C_ENABLED
        default 16
        range 1 64

    config JS_I2C_MAX_TRANSFER_SIZE
        int "Maximum bytes per I2C read or write phase"
        depends on JS_I2C_ENABLED
        default 4096
        range 1 65536

    config JS_I2C_TASK_STACK_SIZE
        int "I2C worker task stack size"
        depends on JS_I2C_ENABLED
        default 3072
        range 2048 8192

    config JS_I2C_TASK_PRIORITY
        int "I2C worker task priority"
        depends on JS_I2C_ENABLED
        default 5
        range 1 24

endmenu
```

## components/js_net/Kconfig
```kconfig
menu "JavaScript network"
    config JS_NET_ENABLED
        bool "Enable the JavaScript network API"
        default y

    config JS_NET_TLS_ENABLED
        bool "Enable verified TLS client connections"
        depends on JS_NET_ENABLED && MBEDTLS_CERTIFICATE_BUNDLE && ESP_TLS_USING_MBEDTLS
        select MBEDTLS_HAVE_TIME
        select MBEDTLS_HAVE_TIME_DATE
        default y

    config JS_NET_MAX_TLS_CONNECTIONS
        int "Maximum TLS connections, including handshakes"
        default 2
        range 1 16

    config JS_NET_MAX_CONNECTIONS
        int "Maximum JS connections and listeners"
        default 16
        range 1 64

    config JS_NET_MAX_PENDING
        int "Maximum pending socket operations"
        default 32
        range 4 128

    config JS_NET_MAX_TRANSFER_SIZE
        int "Maximum bytes per read or write"
        default 16384
        range 256 65536

    config JS_NET_BUFFER_LIMIT
        int "Total pending native I/O buffer budget (bytes)"
        default 65536
        range 4096 524288
endmenu
```

## components/js_pcnt/Kconfig
```kconfig
menu "JavaScript PCNT"
    config JS_PCNT_ENABLED
        bool "Enable the JavaScript pulse counter API"
        depends on IDF_TARGET_ESP32S3
        default y
endmenu
```

## components/js_registers/Kconfig
```kconfig
menu "JavaScript registers"

    config JS_REGISTERS_ENABLED
        bool "Enable the JavaScript registers API"
        default y

    config JS_REGISTERS_MAX_WATCHERS
        int "Maximum JavaScript register watchers"
        depends on JS_REGISTERS_ENABLED
        default 32
        range 1 256

    config JS_REGISTERS_MAX_WATCH_ADDRESSES
        int "Maximum addresses per register watcher"
        depends on JS_REGISTERS_ENABLED
        default 64
        range 1 1024

endmenu
```

## components/js_runtime/Kconfig
```kconfig
menu "QuickJS runtime"

    config JS_EVENT_QUEUE_LENGTH
        int "Event queue length"
        default 32
        range 4 256

    config JS_RUNTIME_CONSOLE_QUEUE_LENGTH
        int "Console messages retained per subscriber"
        default 16
        range 4 64

    config JS_RUNTIME_TASK_STACK_SIZE
        int "EventLoop task stack size"
        default 32768
        range 8192 131072

    config JS_RUNTIME_TASK_PRIORITY
        int "EventLoop task priority"
        default 5
        range 1 24

    config JS_RUNTIME_MEMORY_LIMIT_KB
        int "QuickJS heap limit (KiB)"
        default 4096
        range 256 7168

    config JS_RUNTIME_STACK_LIMIT_KB
        int "JavaScript stack limit (KiB)"
        default 24
        range 8 256

    config JS_RUNTIME_CALL_BUDGET_MS
        int "Maximum time for one JavaScript call (ms)"
        default 100
        range 10 10000

    config JS_RUNTIME_MAX_JOBS_PER_TURN
        int "Maximum Promise jobs per EventLoop turn"
        default 64
        range 1 1024

    config JS_RUNTIME_MAX_TIMERS_PER_TURN
        int "Maximum expired timers per EventLoop turn"
        default 32
        range 1 1024

    config JS_RUNTIME_MAX_FILE_MODULES
        int "Maximum LittleFS JavaScript modules per runtime"
        default 64
        range 1 256

    config JS_RUNTIME_MAX_MODULE_SIZE_KB
        int "Maximum size of one LittleFS JavaScript module (KiB)"
        default 64
        range 1 1024

    config JS_RUNTIME_MAX_MODULE_SOURCE_KB
        int "Maximum cumulative LittleFS module source (KiB)"
        default 512
        range 64 4096

endmenu
```

## components/js_uart/Kconfig
```kconfig
menu "JavaScript UART"

    config JS_UART_ENABLED
        bool "Enable the JavaScript UART API"
        default y

    config JS_UART_MAX_PENDING
        int "Maximum pending operations per UART"
        depends on JS_UART_ENABLED
        default 16
        range 1 64

    config JS_UART_DEFAULT_BUFFER_SIZE
        int "Default RX and TX buffer size"
        depends on JS_UART_ENABLED
        default 2048
        range 256 16384

    config JS_UART_MAX_TRANSFER_SIZE
        int "Maximum bytes per read or write"
        depends on JS_UART_ENABLED
        default 4096
        range 64 65536

    config JS_UART_TASK_STACK_SIZE
        int "UART worker task stack size"
        depends on JS_UART_ENABLED
        default 3072
        range 2048 8192

    config JS_UART_TASK_PRIORITY
        int "UART worker task priority"
        depends on JS_UART_ENABLED
        default 5
        range 1 24

endmenu
```

## components/modbus_tcp/Kconfig
```kconfig
menu "Modbus TCP server"
    config MODBUS_TCP_MAX_CLIENTS
        int "Maximum simultaneous Modbus TCP clients"
        default 2
        range 1 8
    config MODBUS_TCP_TASK_STACK_SIZE
        int "Modbus TCP task stack size"
        default 6144
        range 4096 16384
endmenu
```

## components/network_manager/Kconfig
```kconfig
menu "Network manager"

    config NETWORK_AP_PREFIX
        string "Default device AP prefix"
        default "JSP32"

    config NETWORK_AP_MAX_CONNECTIONS
        int "Maximum AP clients"
        default 4
        range 1 10

    config NETWORK_CONNECT_TIMEOUT_MS
        int "Station connection timeout (ms)"
        default 30000
        range 5000 120000

    config NETWORK_MAX_RETRIES
        int "Station retries before AP recovery"
        default 5
        range 1 20

    config NETWORK_SCAN_MAX_RESULTS
        int "Maximum scan results"
        default 20
        range 1 50

    config NETWORK_HTTP_MAX_BODY
        int "Maximum network request body"
        default 1024
        range 128 2048

    config NETWORK_TASK_STACK_SIZE
        int "Network manager task stack size"
        default 6144
        range 4096 16384

    config NETWORK_MANAGER_MAX_TX_POWER_QDBM
        int "Maximum Wi-Fi transmit power (quarter dBm)"
        range 8 80
        default 80
        help
            The tested S25FL128S board completed an OTA update at 52 (13 dBm).
            An upload at 60 (15 dBm) failed with Flash erase and program
            errors. Other boards need their own OTA reliability test.

endmenu
```

## components/nvs_http/Kconfig
```kconfig
menu "NVS HTTP API"

    config NVS_HTTP_ENABLED
        bool "Enable the NVS HTTP API"
        default y

    config NVS_HTTP_MAX_CONCURRENT_REQUESTS
        int "Maximum concurrent NVS requests"
        depends on NVS_HTTP_ENABLED
        default 2
        range 1 4

    config NVS_HTTP_MAX_BODY_SIZE
        int "Maximum JSON request body size"
        depends on NVS_HTTP_ENABLED
        default 12288
        range 1024 65536

    config NVS_HTTP_MAX_STRING_SIZE
        int "Maximum string value size"
        depends on NVS_HTTP_ENABLED
        default 2048
        range 1 16384

    config NVS_HTTP_MAX_BLOB_SIZE
        int "Maximum decoded blob size"
        depends on NVS_HTTP_ENABLED
        default 8192
        range 1 65536

    config NVS_HTTP_MAX_BATCH_OPERATIONS
        int "Maximum operations in one batch"
        depends on NVS_HTTP_ENABLED
        default 32
        range 1 100

    config NVS_HTTP_TASK_STACK_SIZE
        int "NVS HTTP worker stack size"
        depends on NVS_HTTP_ENABLED
        default 8192
        range 4096 16384

    config NVS_HTTP_TASK_PRIORITY
        int "NVS HTTP worker priority"
        depends on NVS_HTTP_ENABLED
        default 4
        range 1 24

endmenu
```

## components/ota_http/Kconfig
```kconfig
menu "OTA HTTP API"

    config OTA_HTTP_ENABLED
        bool "Enable the OTA HTTP API"
        default y

    config OTA_HTTP_TASK_STACK_SIZE
        int "OTA upload worker stack size"
        depends on OTA_HTTP_ENABLED
        default 8192
        range 4096 16384

    config OTA_HTTP_TASK_PRIORITY
        int "OTA upload worker priority"
        depends on OTA_HTTP_ENABLED
        default 4
        range 1 24

    config OTA_HTTP_REBOOT_DELAY_MS
        int "Delay before reboot after responding"
        depends on OTA_HTTP_ENABLED
        default 500
        range 100 5000

endmenu
```

## components/reg_http/Kconfig
```kconfig
menu "Register HTTP API"
    config REG_HTTP_ENABLED
        bool "Enable register HTTP API"
        default y

    config REG_HTTP_MAX_SSE_CLIENTS
        int "Maximum register event stream clients"
        depends on REG_HTTP_ENABLED
        default 2
        range 1 4
endmenu
```
